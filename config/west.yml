## config/west.yml
```yaml
manifest:
  remotes:
    - name: zmkfirmware
      url-base: https://github.com/mralex07
  projects:
    - name: zmk_tr
      remote: zmkfirmware
      revision: pmw3610-aml
      import: app/west.yml
  self:
    path: config
```
